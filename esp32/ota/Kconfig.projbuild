## esp32/ota/Kconfig.projbuild
```kconfig
menu "OTA Update Configuration"

    config OTA_WIFI_SSID
        string "Wi-Fi SSID"
        default "myssid"

    config OTA_WIFI_PASSWORD
        string "Wi-Fi Password"
        default "mypassword"

    config OTA_SERVER_URL
        string "OTA Firmware URL (HTTPS)"
        default "https://vibething.ai/firmware.bin"
        help
            Full HTTPS URL to the firmware binary. HTTP is rejected at compile time.

    config OTA_WIFI_MAX_RETRY
        int "Maximum Wi-Fi reconnect attempts"
        default 5
        range 1 20

    config OTA_RECV_TIMEOUT_MS
        int "HTTP receive timeout (ms)"
        default 5000
        range 1000 30000

    config OTA_TASK_STACK_SIZE
        int "OTA task stack size (bytes)"
        default 8192
        range 4096 16384

    config OTA_TASK_PRIORITY
        int "OTA task FreeRTOS priority"
        default 5
        range 1 24

    config OTA_ALLOW_SAME_VERSION
        bool "Allow re-flashing same firmware version"
        default n
        help
            If disabled, OTA is skipped when the server version matches the
            running version. Enable only for development.

    config OTA_PREVENT_DOWNGRADE
        bool "Prevent firmware downgrade"
        default y
        help
            Reject firmware whose semantic version is lower than the running one.

endmenu
```
